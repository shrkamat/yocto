## pi2/conf/bblayers.conf
```bitbake
# POKY_BBLAYERS_CONF_VERSION is increased each time build/conf/bblayers.conf
# changes incompatibly
POKY_BBLAYERS_CONF_VERSION = "2"

BBPATH = "${TOPDIR}"
BBFILES ?= ""

BBLAYERS ?= " \
  /home/shrkamat/yocto/poky/meta \
  /home/shrkamat/yocto/poky/meta-poky \
  /home/shrkamat/yocto/poky/meta-yocto-bsp \
  /home/shrkamat/yocto/meta-raspberrypi \
  /home/shrkamat/yocto/meta-openembedded/meta-oe \
  /home/shrkamat/yocto/meta-openembedded/meta-networking \
  /home/shrkamat/yocto/meta-openembedded/meta-python \
  /home/shrkamat/yocto/meta-clang \
  "
```
